## boards/arm/zmk40/Kconfig.defconfig
```kconfig
# zmk40 board configuration

# Copyright (c) 2020 The ZMK Contributors
# SPDX-License-Identifier: MIT

if BOARD_ZMK40

config ZMK_KEYBOARD_NAME
	default "zmkPAD"

if USB_DEVICE_STACK

config USB_NRFX
	default y

endif # USB_DEVICE_STACK

config BT_CTLR
	default BT

config ZMK_BATTERY_VOLTAGE_DIVIDER
	default y

endif # BOARD_ZMK40
```
